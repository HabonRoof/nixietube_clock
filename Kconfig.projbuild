## Kconfig.projbuild
```kconfig
config WS2812_LED_COUNT
	int "Number of WS2812 LEDs"
	default 2
	help
		Default number of chained WS2812 LEDs connected to the board's
		one-wire pin. Can be overridden via menuconfig or sdkconfig.defaults.
```
